/ {
    bindings {
        home_z = &mt LGUI &kp Z;
        home_r = &mt LALT &kp R;
        home_s = &mt LSFT &kp S;
        home_t = &mt LCTRL &kp T;

        home_n = &mt RCTRL &kp N;
        home_e = &mt RSFT &kp E;
        home_i = &mt LALT &kp I;
        home_o = &mt RGUI &kp O;

        lt_num = &lt NUM &kp LGUI;
        lt_nav = &lt NAV &kp SPC;
        lt_sym = &lt SYM &kp ENT;
        lt_fn_eq = &lt FN &kp EQUAL;

        algr_bspc = &altgr &kp BSPC;

        lgui_e = &kp LC(E);
    };
};
